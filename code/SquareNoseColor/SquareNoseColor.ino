// SQUARE NOSE COLOR by Juice Lizard on Gamebuino Meta
// adding Lethal Mouse and cheat code for level selection
// last update: 17-06-2019

#include <Gamebuino-Meta.h>

// position of letter "O" in title screen changes with Lethal Mouse
//#define GAME_LOOP_NUMBERS_X 31

#define BIRD_Y 2
#define BUG_Y 33

const uint8_t SquareN_seColorData[] = {80, 64, 1, 0, 1, 0x0E, 1, 0x00, 0x00,0x00, 0x00,0x00, 0x00,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0x00, 0x00};
Image SquareN_seColor = Image(SquareN_seColorData);

const uint8_t LethalM_useColorData[] = {80, 64, 1, 0, 1, 0x0E, 1, 0x00, 0x00,0x00, 0x00,0x00, 0x00,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0x00, 0x00};
Image LethalM_useColor = Image(LethalM_useColorData);

const uint8_t gameLoopNumbersData[] = {8, 80, 1, 0, 1, 0xFF, 1, 0x77, 0x77,0x77, 0x77,0x77, 0x77,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0x77, 0x77};
Image gameLoopNumbers = Image(gameLoopNumbersData);

const uint8_t SquareNoseRightData[] = {10, 12, 1, 0, 1, 0x03, 1, 0x33, 0x00,0x00, 0x03,0x33, 0x30,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0x00, 0x33};
Image SquareNoseRight = Image(SquareNoseRightData);

const uint8_t LethalMouseRightData[] = {10, 12, 1, 0, 1, 0x03, 1, 0x33, 0x00,0x00, 0x03,0x33, 0x30,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0x00, 0x33};
Image LethalMouseRight = Image(LethalMouseRightData);

const uint8_t SquareNoseRunsRightData[] = {10, 12, 2, 0, 2, 0x03, 1, 0x33, 0x00,0x00, 0x03,0x33, 0x30,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0x00, 0x33};
Image SquareNoseRunsRight = Image(SquareNoseRunsRightData);

const uint8_t LethalMouseRunsRightData[] = {10, 12, 1, 0, 1, 0x03, 1, 0x33, 0x00,0x00, 0x03,0x33, 0x30,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0x00, 0x33};
Image LethalMouseRunsRight = Image(LethalMouseRunsRightData);

const uint8_t LethalMouseBlinkRightData[] = {10, 12, 2, 0, 3, 0x03, 1, 0x33, 0x00,0x00, 0x03,0x33, 0x30,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0x00, 0x33};
Image LethalMouseBlinkRight = Image(LethalMouseBlinkRightData);

const uint8_t SquareNoseLeftData[] = {10, 12, 1, 0, 1, 0x03, 1, 0x33, 0x30,0x00, 0x00,0x33, 0x33,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0x00, 0x03};
Image SquareNoseLeft = Image(SquareNoseLeftData);

const uint8_t LethalMouseLeftData[] = {10, 12, 1, 0, 1, 0x03, 1, 0x33, 0x30,0x00, 0x00,0x33, 0x33,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0x00, 0x03};
Image LethalMouseLeft = Image(LethalMouseLeftData);

const uint8_t SquareNoseRunsLeftData[] = {10, 12, 2, 0, 2, 0x03, 1, 0x33, 0x30,0x00, 0x00,0x33, 0x33,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0x00, 0x03};
Image SquareNoseRunsLeft = Image(SquareNoseRunsLeftData);

const uint8_t LethalMouseRunsLeftData[] = {10, 12, 1, 0, 1, 0x03, 1, 0x33, 0x30,0x00, 0x00,0x33, 0x33,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0x00, 0x00};
Image LethalMouseRunsLeft = Image(LethalMouseRunsLeftData);

const uint8_t LethalMouseBlinkLeftData[] = {10, 12, 2, 0, 3, 0x03, 1, 0x33, 0x30,0x00, 0x00,0x33, 0x33,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0x00, 0x03};
Image LethalMouseBlinkLeft = Image(LethalMouseBlinkLeftData);

/*
const uint8_t SN_ball_clockData[] = {10, 10, 4, 0, 1, 0x0E, 1, 0xee, 0xe0,0x00, 0x0e,0xee, 0xee,0x00, 0x44,0x00, 0xee,0xe0, 0x04,0x4f, 0x40,0x0e, 0x00,0x44, 0x44,0xf4, 0x00,0x04, 0x44,0x44, 0x44,0x40, 0x04,0x44, 0x44,0x44, 0x40,0x00, 0x44,0x44, 0x44,0x00, 0xe0,0x04, 0x44,0x40, 0x0e,0xee, 0x00,0x44, 0x00,0xee, 0xee,0xe0, 0x00,0x0e, 0xee,0xee, 0xe0,0x00, 0x0e,0xee, 0xee,0x00, 0x44,0x00, 0xee,0xe0, 0x04,0x44, 0x40,0x0e, 0x00,0x44, 0x44,0x44, 0x00,0x04, 0x44,0x44, 0x44,0x40, 0x04,0x44, 0x44,0x4f, 0x40,0x00, 0x44,0x44, 0xf4,0x00, 0xe0,0x04, 0x44,0x40, 0x0e,0xee, 0x00,0x44, 0x00,0xee, 0xee,0xe0, 0x00,0x0e, 0xee,0xee, 0xe0,0x00, 0x0e,0xee, 0xee,0x00, 0x44,0x00, 0xee,0xe0, 0x04,0x44, 0x40,0x0e, 0x00,0x44, 0x44,0x44, 0x00,0x04, 0x44,0x44, 0x44,0x40, 0x04,0x44, 0x44,0x44, 0x40,0x00, 0x4f,0x44, 0x44,0x00, 0xe0,0x04, 0xf4,0x40, 0x0e,0xee, 0x00,0x44, 0x00,0xee, 0xee,0xe0, 0x00,0x0e, 0xee,0xee, 0xe0,0x00, 0x0e,0xee, 0xee,0x00, 0x44,0x00, 0xee,0xe0, 0x04,0x44, 0x40,0x0e, 0x00,0x4f, 0x44,0x44, 0x00,0x04, 0xf4,0x44, 0x44,0x40, 0x04,0x44, 0x44,0x44, 0x40,0x00, 0x44,0x44, 0x44,0x00, 0xe0,0x04, 0x44,0x40, 0x0e,0xee, 0x00,0x44, 0x00,0xee, 0xee,0xe0, 0x00,0x0e, 0xee};
Image SN_ball_clock = Image(SN_ball_clockData);

const uint8_t SN_ball_counter_clockData[] = {10, 10, 4, 0, 1, 0x0E, 1, 0xee, 0xe0,0x00, 0x0e,0xee, 0xee,0x00, 0x44,0x00, 0xee,0xe0, 0x04,0xf4, 0x40,0x0e, 0x00,0x4f, 0x44,0x44, 0x00,0x04, 0x44,0x44, 0x44,0x40, 0x04,0x44, 0x44,0x44, 0x40,0x00, 0x44,0x44, 0x44,0x00, 0xe0,0x04, 0x44,0x40, 0x0e,0xee, 0x00,0x44, 0x00,0xee, 0xee,0xe0, 0x00,0x0e, 0xee,0xee, 0xe0,0x00, 0x0e,0xee, 0xee,0x00, 0x44,0x00, 0xee,0xe0, 0x04,0x44, 0x40,0x0e, 0x00,0x44, 0x44,0x44, 0x00,0x04, 0x44,0x44, 0x44,0x40, 0x04,0xf4, 0x44,0x44, 0x40,0x00, 0x4f,0x44, 0x44,0x00, 0xe0,0x04, 0x44,0x40, 0x0e,0xee, 0x00,0x44, 0x00,0xee, 0xee,0xe0, 0x00,0x0e, 0xee,0xee, 0xe0,0x00, 0x0e,0xee, 0xee,0x00, 0x44,0x00, 0xee,0xe0, 0x04,0x44, 0x40,0x0e, 0x00,0x44, 0x44,0x44, 0x00,0x04, 0x44,0x44, 0x44,0x40, 0x04,0x44, 0x44,0x44, 0x40,0x00, 0x44,0x44, 0xf4,0x00, 0xe0,0x04, 0x4f,0x40, 0x0e,0xee, 0x00,0x44, 0x00,0xee, 0xee,0xe0, 0x00,0x0e, 0xee,0xee, 0xe0,0x00, 0x0e,0xee, 0xee,0x00, 0x44,0x00, 0xee,0xe0, 0x04,0x44, 0x40,0x0e, 0x00,0x44, 0x44,0xf4, 0x00,0x04, 0x44,0x44, 0x4f,0x40, 0x04,0x44, 0x44,0x44, 0x40,0x00, 0x44,0x44, 0x44,0x00, 0xe0,0x04, 0x44,0x40, 0x0e,0xee, 0x00,0x44, 0x00,0xee, 0xee,0xe0, 0x00,0x0e, 0xee};
Image SN_ball_counter_clock = Image(SN_ball_counter_clockData);

const uint8_t SquareNoseBallData[] = {10, 10, 1, 0, 1, 0x0E, 1, 0xee, 0xe0,0x00, 0x0e,0xee, 0xee,0x00, 0x44,0x00, 0xee,0xe0, 0x04,0x4f, 0x40,0x0e, 0x00,0x44, 0x44,0xf4, 0x00,0x04, 0x44,0x44, 0x44,0x40, 0x04,0x44, 0x44,0x44, 0x40,0x00, 0x44,0x44, 0x44,0x00, 0xe0,0x04, 0x44,0x40, 0x0e,0xee, 0x00,0x44, 0x00,0xee, 0xee,0xe0, 0x00,0x0e, 0xee};
Image SquareNoseBall = Image(SquareNoseBallData);
*/

const uint8_t SN_ball_clockData[] = {10, 10, 4, 0, 1, 0x0E, 1, 0xee, 0xe0,0x00, 0x0e,0xee, 0xe0,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0x0e, 0xee};
Image SN_ball_clock = Image(SN_ball_clockData);

const uint8_t SN_ball_counter_clockData[] = {10, 10, 4, 0, 1, 0x0E, 1, 0xee, 0xe0,0x00, 0x0e,0xee, 0xe0,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0x0e, 0xee};
Image SN_ball_counter_clock = Image(SN_ball_counter_clockData);

const uint8_t SquareNoseBallData[] = {10, 10, 1, 0, 1, 0x0E, 1, 0xee, 0xe0,0x00, 0x0e,0xee, 0xe0,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0x0e, 0xee};
Image SquareNoseBall = Image(SquareNoseBallData);

const uint8_t SquareNoseElectricData[] = {10, 12, 2, 0, 2, 0x0E, 1, 0xee, 0x00,0x00, 0x00,0xee, 0xee,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0x77, 0x7e};
Image SquareNoseElectric = Image(SquareNoseElectricData);

const uint8_t meatyRingData[] = {8, 8, 4, 0, 3, 0x0E, 1, 0xee, 0x00,0x00, 0xee,0xe0, 0x0f,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0x00, 0xee};
Image meatyRing = Image(meatyRingData);

const uint8_t birdRightData[] = {12, 8, 2, 0, 4, 0x0E, 1, 0xe0, 0x00,0x0e, 0xee,0xee, 0xee,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0xee, 0xee};
Image birdRight = Image(birdRightData);

const uint8_t birdLeftData[] = {12, 8, 2, 0, 4, 0x0E, 1, 0xee, 0xee,0xee, 0x00,0x00, 0xee,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0x00, 0xee};
Image birdLeft = Image(birdLeftData);

const uint8_t bugLeftData[] = {10, 7, 2, 0, 3, 0x0E, 1, 0xee, 0xe0,0x00, 0x00,0xee, 0x00,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0xee, 0xee};
Image bugLeft = Image(bugLeftData);

const uint8_t bugRightData[] = {10, 7, 2, 0, 3, 0x0E, 1, 0xe0, 0x00,0x00, 0xee,0xee, 0x00,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0xee, 0xee};
Image bugRight = Image(bugRightData);

const uint8_t frogGroundData[] = {12, 12, 1, 0, 1, 0x0C, 1, 0xcc, 0x00,0x00, 0x00,0x00, 0xcc,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0x00, 0x00};
Image frogGround = Image(frogGroundData);

const uint8_t frogAirData[] = {12, 14, 1, 0, 1, 0x0C, 1, 0xcc, 0x00,0x00, 0x00,0x00, 0xcc,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0x00, 0x00};
Image frogAir = Image(frogAirData);

const uint8_t SquiddyData[] = {10, 10, 1, 0, 1, 0x0E, 1, 0x00, 0x00,0x00, 0x00,0x00, 0x08,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0x00, 0x00};
Image Squiddy = Image(SquiddyData);

const uint8_t SquiddyBallData[] = {10, 10, 1, 0, 1, 0x0E, 1, 0xee, 0xe0,0x00, 0x0e,0xee, 0xe0,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0x0e, 0xee};
Image SquiddyBall = Image(SquiddyBallData);

const uint8_t ATRUEPETData[] = {74, 18, 1, 0, 1, 0x00, 1, 0x77, 0x77,0x77, 0x77,0x77, 0x00,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0x07, 0x77};
Image ATRUEPET = Image(ATRUEPETData);

const uint8_t openHandData[] = {22, 22, 1, 0, 1, 0x0D, 1, 0xd0, 0xff,0xff, 0xff,0xff, 0xff,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0xdd, 0xdd};
Image openHand = Image(openHandData);

const uint8_t closedHandData[] = {22, 22, 1, 0, 1, 0x0D, 1, 0xd0, 0xff,0xff, 0xff,0xff, 0xff,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0xdd, 0xdd};
Image closedHand = Image(closedHandData);

const uint8_t LethalMouseCapturedData[] = {22, 22, 1, 0, 1, 0x0D, 1, 0xd0, 0xff,0xff, 0xff,0xff, 0xff,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0xdd, 0xdd};
Image LethalMouseCaptured = Image(LethalMouseCapturedData);

const uint8_t handSquiddyData[] = {22, 22, 1, 0, 1, 0x0D, 1, 0xd0, 0xff,0xff, 0xff,0xff, 0xff,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0xdd, 0xdd};
Image handSquiddy = Image(handSquiddyData);

const uint8_t bigBirdData[] = {34, 24, 1, 0, 1, 0x0E, 1, 0xee, 0xe0,0x00, 0x00,0x00, 0x00,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0xee, 0xee};
Image bigBird = Image(bigBirdData);

const uint8_t bigBugData[] = {28, 21, 1, 0, 1, 0x0E, 1, 0xee, 0xee,0xee, 0xee,0xe0, 0x00,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0xee, 0xee};
Image bigBug = Image(bigBugData);

const uint8_t bigFrogData[] = {36, 36, 1, 0, 1, 0x0C, 1, 0xcc, 0xcc,0xcc, 0x00,0x00, 0x00,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0x00, 0x00};
Image bigFrog = Image(bigFrogData);

const uint8_t bigSquiddyBallData[] = {30, 30, 1, 0, 1, 0x0E, 1, 0xee, 0xee,0xee, 0xee,0xe0, 0x00,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0xee, 0xee};
Image bigSquiddyBall = Image(bigSquiddyBallData);

const uint8_t bigSquareNoseBallData[] = {30, 30, 1, 0, 1, 0x0E, 1, 0xee, 0xee,0xee, 0xee,0xe0, 0x00,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0xee, 0xee};
Image bigSquareNoseBall = Image(bigSquareNoseBallData);

const uint8_t bigSquiddyData[] = {30, 30, 1, 0, 1, 0x0E, 1, 0x00, 0x00,0x00, 0x00,0x00, 0x00,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0x00, 0x00};
Image bigSquiddy = Image(bigSquiddyData);

const uint8_t bigSquareNoseData[] = {30, 36, 1, 0, 1, 0x03, 1, 0x33, 0x33,0x33, 0x00,0x00, 0x00,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0x33, 0x33};
Image bigSquareNose = Image(bigSquareNoseData);

const uint8_t bigLethalMouseData[] = {30, 36, 1, 0, 1, 0x03, 1, 0x33, 0x33,0x33, 0x33,0x30, 0x00,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0x03, 0x33};
Image bigLethalMouse = Image(bigLethalMouseData);

const uint8_t pinkHeartData[] = {10, 8, 5, 0, 3, 0x03, 1, 0x3e, 0xe2,0x33, 0xee,0x23, 0xee,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0x33, 0x33};
Image pinkHeart = Image(pinkHeartData);

const uint8_t blueTargetData[] = {10, 9, 4, 0, 4, 0x0E, 1, 0xee, 0xe0,0x00, 0xee,0xee, 0xe0,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0xee, 0xee};
Image blueTarget = Image(blueTargetData);

/*
const uint8_t bushData[] = {14, 9, 1, 0, 1, 0x0E, 1, 0xee, 0xee,0xee, 0xbb,0xee, 0xee,0xee, 0xee,0xee, 0xeb,0xbb, 0xbb,0xee, 0xee,0xee, 0xee,0xbb, 0x3b,0x3b, 0xee,0xee, 0xee,0xee, 0xb3,0xbb, 0xbb,0xbe, 0xee,0xeb, 0xbb,0xbb, 0xbb,0xbb, 0xbe,0xbe, 0xbb,0xbb, 0xbb,0xbb, 0xbb,0xbb, 0xbb,0xbb, 0x33,0xbb, 0x3b,0xbb, 0xbb,0xbe, 0xeb,0xbb, 0x33,0xb3, 0x3b,0xbb, 0xbb,0xee, 0xeb,0xbb, 0xeb,0xbb, 0xeb,0x00be};
Image bush = Image(bushData);

const uint8_t cloudData[] = {14, 9, 1, 0, 1, 0x0E, 1, 0xee, 0xee,0xee, 0x77,0xee, 0xee,0xee, 0xee,0xee, 0xe7,0x77, 0x77,0xee, 0xee,0xee, 0xee,0x77, 0xc7,0xc7, 0xee,0xee, 0xee,0xee, 0x7c,0x77, 0x77,0x7e, 0xee,0xe7, 0x77,0x77, 0x77,0x77, 0x7e,0x7e, 0x77,0x77, 0x77,0x77, 0x77,0x77, 0x77,0x77, 0xcc,0x77, 0xc7,0x77, 0x77,0x7e, 0xe7,0x77, 0xcc,0x7c, 0xc7,0x77, 0x77,0xee, 0xe7,0x77, 0xe7,0x77, 0xe7,0x007e};
Image cloud = Image(cloudData);
*/

int gameState = 1;
int level = 0;
int gameLoop = 0;
int gameLoopNumbersY = -52;
int sentenceNumber = -1;
int cheatCodeNumber = 0;
bool selectLevel = false;

// timer
int frameCounter = 0;
int seconds = 0;
int minutes = 0;

// Square Nose
int SquareNoseX = 16;
int SquareNoseY = 28;
bool SquareNoseGoesRight = true;
bool SquareNoseIsJumping = false;
int SquareNoseJumpSpeed = 0;
int SquareNoseJumpCounter = 0;
bool electricShock = false;
int electricX = 0;
int electricY = 0;

// meaty ring
int meatyRingX = 52;
int meatyRingY = 8;
int collectedMeatyRings = 0;

// bird
int birdX = 18;
bool birdGoesRight = false;

// bug
int bugX = 54;
bool bugGoesRight = true;

// frog
int frogX = 50;
int frogY = 28;
bool frogGoesRight = true;
bool frogIsJumping = false;
int frogJumpSpeed = 0;
int frogJumpCounter = 0;

// Squiddy
int SquiddyX = 42;
int SquiddyY = 30;

int SquiddyBallX = 54;
int SquiddyBallY = 8;

int angle = 0;
bool SquiddySpins = false;

// doctor Meggan arm
bool endOfTest = false;
bool handGoesDown = true;
int handY = -22;

// big sprites animation
int smallMove = 0;
bool leftEye = false;
bool rightEye = false;

// play with Lethal Mouse
bool playLethalMouse = false;

// Lethal Mouse moves
bool LethalMouseMoves = false;
int madLethalMouse = 0;
int colorNumber = 0;

//
int gameLoopNumbersX = 31;

bool deadBird = false;
bool deadBug = false;
bool deadFrog = false;
bool deadSquiddy = false;
bool deadSquareNoseBall = false;

void setup() {
  gb.begin();
}

void loop() {
  while(!gb.update());
  gb.display.clear();

  switch (gameState) {
// title screen
    case 1:
// random music for Lethal Mouse
      if(playLethalMouse == true) {
        if((gb.frameCount % 4) == 0) {
          gb.sound.tone(random(200, 800), 100);
        }
      }
// draw the screen
      gameLoopNumbersY = (level * 8) - 52;
      gb.display.drawImage(gameLoopNumbersX, gameLoopNumbersY, gameLoopNumbers);
      if(playLethalMouse == true) {
        gb.display.drawImage(0, 0, LethalM_useColor);
      } else {
        gb.display.drawImage(0, 0, SquareN_seColor);
      }

// choose to play with Lethal Mouse or Square Nose
      if((gb.buttons.repeat(BUTTON_B, 0)) && (gb.buttons.pressed(BUTTON_UP))) {
        if(playLethalMouse == false) {
          playLethalMouse = true;
          gameLoopNumbersX = 26;
        } else {
          playLethalMouse = false;
          gameLoopNumbersX = 31;
        }
      }
      
// cheat code to select the level: UP, DOWN, LEFT, RIGHT
      if(selectLevel == false) {
        if(gb.buttons.pressed(BUTTON_UP)) {
          if(cheatCodeNumber == 0) {
            cheatCodeNumber = 1;
          } else {
            cheatCodeNumber = 0;
          }
        }
        if(gb.buttons.pressed(BUTTON_DOWN)) {
          if(cheatCodeNumber == 1) {
            cheatCodeNumber = 2;
          } else {
            cheatCodeNumber = 0;
          }
        }
        if(gb.buttons.pressed(BUTTON_LEFT)) {
          if(cheatCodeNumber == 2) {
            cheatCodeNumber = 3;
          } else {
            cheatCodeNumber = 0;
          }
        }
        if(gb.buttons.pressed(BUTTON_RIGHT)) {
          if(cheatCodeNumber == 3) {
            selectLevel = true;
            cheatCodeNumber = 0;
            level += 1;
          } else {
            cheatCodeNumber = 0;
          }
        }
      } else {
// level selection
        if((gb.buttons.pressed(BUTTON_RIGHT)) && (level < 3)) {
          level += 1;
        }
        if((gb.buttons.pressed(BUTTON_LEFT)) && (level > 0)) {
          level -= 1;
        }
      }
// go to playable levels      
      if(gb.buttons.pressed(BUTTON_A)) {
        if((selectLevel == false) || (level == 0)) {
          gameState = 2; // playable level 0 (wild nature)
        } else {
          level -= 1;
          gameState = 3; // presentation screens
        }
        cheatCodeNumber = 0;
        selectLevel = false;
      }
      break;

// game
    case 2:
      inputs();
      updates();
      outputs();
      break;

// screens between the levels
    case 3:
      if(level < 3) {
        gb.display.drawImage(3, 3, ATRUEPET);
      } else {
        gb.display.setFontSize(2);
        gb.display.setCursor(9, 6);
        switch(gameLoop) {
          case 0:
            gb.display.setColor(RED);
            break;
          case 1:
            gb.display.setColor(YELLOW);
            break;
          case 2:
            gb.display.setColor(GREEN);
            break;
          case 3:
            gb.display.setColor(LIGHTBLUE);
            break;
          case 4:
            gb.display.setColor(DARKBLUE);
            break;
          case 5:
            gb.display.setColor(PURPLE);
            break;
          case 6:
            gb.display.setColor(PINK);
            break;
          case 7:
            gb.display.setColor(ORANGE);
            break;
          case 8:
            gb.display.setColor(WHITE);
            break;
          case 9:
            gb.display.setColor(LIGHTGREEN);
            break;
          case 10:
            gb.display.setColor(BLUE);
            break;
          case 11:
            gb.display.setColor(DARKGRAY);
            break;
          case 12:
            gb.display.setColor(BEIGE);
            break;
          case 13:
            gb.display.setColor(GRAY);
            break;
          case 14:
            gb.display.setColor(BROWN);
            break;
        }
        if(gameLoop > 14) {
          gb.display.setColor(WHITE);
          gb.display.setCursor(9 + random(-1, 2), 4 + random(-1, 2));
        }
        gb.display.print("THE END?");
      }
// draw next animals in big
      switch(level) {
        case 0:
          gb.display.drawImage(1 + smallMove, 25, bigBird);
          gb.display.drawImage(52 - smallMove, 40, bigBug);
          break;
        case 1:
          gb.display.drawImage(22, 31 - smallMove, bigFrog);
          break;
        case 2:
          if(playLethalMouse == true) {
            gb.display.drawImage(6, 25 + smallMove, bigSquareNoseBall);
          } else {
            gb.display.drawImage(6, 25 + smallMove, bigSquiddyBall);
          }
          gb.display.drawImage(44, 31 - smallMove, bigSquiddy);
          break;
        case 3:
          gb.display.drawImage(5, 25, bigSquareNose);
          gb.display.drawImage(45, 25, bigLethalMouse);
// random blinking red eyes for Lethal Mouse
          if(random(8) == 5) {
            if(leftEye == true) {
              leftEye = false;
            } else {
              leftEye = true;
            }
          }
          if(leftEye == true) {
            gb.display.setColor(BLACK);
            gb.display.fillRect(57, 34, 3, 3);
          }
          if(random(8) == 5) {
            if(rightEye == true) {
              rightEye = false;
            } else {
              rightEye = true;
            }
          }
          if(rightEye == true) {
            gb.display.setColor(BLACK);
            gb.display.fillRect(63, 34, 3, 3);
          }
// draw a spinnig heart between Square Nose and Lethal Mouse
//          gb.display.drawImage(35, 25, pinkHeart);
          break;
      }

      if(smallMove < 6) {
        smallMove += 1;
      }
      
// print a negative sentence
/*        gb.display.setCursorY(32);
        gb.display.setColor(GRAY);
        switch(sentenceNumber) {
          case 0:
            gb.display.print("\n\n\nYou failed to lose.\nGood!");
            break;
          case 1:
            gb.display.print("\n\n\n\nWhy did you do that?");
            break;
          case 2:
            gb.display.print("\nDo you know the joke\nabout the slave who\nthought he were\nfree?");
            break;
          case 3:
            gb.display.print("\n\n\nWho told you to do\nthat?");
            break;
          case 4:
            gb.display.print("\n\n\nHow do you know what\nis good or bad?");
            break;
          case 5:
            gb.display.print("\n\nDo you understand\nthe meaning of your\nactions?");
            break;
          case 6:
            gb.display.print("\n\n\nWhere does all of\nthis lead?");
            break;
          case 7:
            gb.display.print("\n\nDo you feel respon-\nsible for what is\njust happening?");
            break;
          case 8:
            gb.display.print("\n\n\nPut this and take a\nbook.");
            break;
          case 9:
            gb.display.print("\n\n\nDo you like losing\ntime?");
            break;
          case 10:
            gb.display.print("\n\nIs this comfort\nreally protecting\nyou?");
            break;
          case 11:
            gb.display.print("\n\nThink about the\npeople who have no\nfingers.");
            break;
          case 12:
            gb.display.print("\n\n\nIs this thing re-\nlated to real life?");
            break;
          case 13:
            gb.display.print("\n\n\n\nDo trees suffer?");
            break;
          case 14:
            gb.display.print("\n\nYou never learn from\nyour mistakes. Do\nyou?");
            break;
          case 15:
            gb.display.print("I can't love you, I\nam not human.");
            break;
          case 16:
            gb.display.print("\n\nAre you really\ndifferent from the\nothers?");
            break;
          case 17:
            gb.display.print("\n\n\nThis has not been\nwritten for you.");
            break;
        }
*/

// got to next level or go back to title screen      
      if(gb.buttons.pressed(BUTTON_A)) {
        if(level == 3) {
          level = 0;
          gameLoop += 1;
          frameCounter = 0;
          seconds = 0;
          minutes = 0;
          gameState = 1;
          sentenceNumber = -1;
        } else {
          level += 1;
          gameState = 2;
          sentenceNumber = random(0, 18);
        }
        smallMove = 0;
      }
      break;
  }
}
